## conf/layer.conf
```bitbake
BBPATH .= ":${LAYERDIR}"
BBFILES += "${LAYERDIR}/recipes-*/*/*.bb \
            ${LAYERDIR}/recipes-*/*/*.bbappend"

# Let us add layer-specific bbappends which are only applied when that
# layer is included in our configuration
BBFILES += "${@' '.join('${LAYERDIR}/%s/recipes*/*/*.bbappend' % layer \
               for layer in BBFILE_COLLECTIONS.split())}"

BBFILE_COLLECTIONS += "ro-rootfs"
BBFILE_PRIORITY_ro-rootfs = "10"
BBFILE_PATTERN_ro-rootfs = "^${LAYERDIR}/"
LAYERDEPENDS_ro-rootfs = "core"
```
